## config/boards/shields/rgo/Kconfig.defconfig
```kconfig
if SHIELD_RGO_LEFT

config ZMK_KEYBOARD_NAME
    default "rgo"

config ZMK_SPLIT_ROLE_CENTRAL
    default y

endif

if SHIELD_RGO_LEFT || SHIELD_RGO_RIGHT

config ZMK_SPLIT
    default y

endif
```

## config/boards/shields/rgo/Kconfig.shield
```kconfig
config SHIELD_RGO_LEFT
    def_bool $(shields_list_contains,rgo_left)

config SHIELD_RGO_RIGHT
    def_bool $(shields_list_contains,rgo_right) 
```

## recmac/Kconfig
```kconfig
DT_COMPAT_ZMK_BEHAVIOR_RECORDED_MACRO := zmk,behavior-recorded-macro

config ZMK_BEHAVIOR_RECORDED_MACRO
    bool
    default $(dt_compat_enabled,$(DT_COMPAT_ZMK_BEHAVIOR_RECORDED_MACRO))

if ZMK_BEHAVIOR_RECORDED_MACRO

config ZMK_RECORDED_MACRO_MAX_EVENTS
    int "Maximum events per recorded macro (a keystroke is a press and a release, so 2 events)"
    default 128

config ZMK_RECORDED_MACRO_WAIT_MS
    int "Time to wait (in milliseconds) between events when playing back"
    default 10

config ZMK_RECORDED_MACRO_PASSTHROUGH
    bool "Also send keys to the computer while recording"
    default n

endif
```

## recmac/dts/bindings/behaviors/zmk,behavior-recorded-macro.yaml
```yaml
description: Record a key sequence at runtime, keep it in flash, and play it back

compatible: "zmk,behavior-recorded-macro"

include: one_param.yaml
```
